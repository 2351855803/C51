#include<reg52.h>
#include<intrins.h>

//--------------------------------------------------//延时500ms
void Delay500ms(){
	unsigned char i, j, k;

	_nop_();
	i = 4;
	j = 205;
	k = 187;
	do
	{
		do
		{
			while (--k);
		} while (--j);
	} while (--i);
}

int main()
{
	//--------------------------------------------------//LED点亮
												
	//由于LED均是共阴极连接，则低电平可点亮
	//通过P2来分别控制
	//控制第一个亮 0X 1111 1110 
    //P2 = 0xfe;
	
	//--------------------------------------------------//LED闪烁	
//	while(1)
//	{
//		P2 = 0xfe;
//		Delay500ms();
//		P2 = 0x7f;
//		Delay500ms();
//	}
	
	//--------------------------------------------------//流水灯
	P2 = 0xfe;
	while(1)
	{
//    11111110
//		11111100 | 00000001
		
		//复位
		if(0x7f == P2)
		{
			P2 = 0xfe;
		}
		
		P2 = (P2 << 1) | 0x01;
		Delay500ms();
	}
	
	
	return 0;
}